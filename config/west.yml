## config/west.yml
```yaml
manifest:
  remotes:
    - name: zmkfirmware
      url-base: https://github.com/zmkfirmware
    - name: CYCLOP5
      url-base: https://github.com/CYCLOP5

  projects:
    - name: zmk
      remote: zmkfirmware
      revision: main
      import: app/west.yml
    - name: bad-apple-zmk        
      remote: CYCLOP5       
      revision: main

  self:
    path: config
```
